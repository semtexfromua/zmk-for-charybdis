## config/boards/shields/charybdis/Kconfig.defconfig
```kconfig
if SHIELD_CHARYBDIS_RIGHT

config ZMK_KEYBOARD_NAME
	default "Charybdis"

config ZMK_SPLIT_BLE_ROLE_CENTRAL
	default y

# Додаємо опцію для кастомного input processor
# CONFIG_INPUT_PROCESSOR_CARET=y

endif

if SHIELD_CHARYBDIS_LEFT || SHIELD_CHARYBDIS_RIGHT

config ZMK_SPLIT
	default y
	
endif
```

## config/boards/shields/charybdis/Kconfig.shield
```kconfig
config SHIELD_CHARYBDIS_LEFT
    def_bool $(shields_list_contains,charybdis_left)

config SHIELD_CHARYBDIS_RIGHT
    def_bool $(shields_list_contains,charybdis_right)

# Додаємо опцію для кастомного input processor
# Kconfig для CARET процесора

config INPUT_PROCESSOR_CARET
	bool "Support for ZMK caret input processor"
	default n
	depends on ZMK_MOUSE
	help
	  This option enables support for the caret input processor,
	  which converts trackball movements to arrow key presses.
```

## config/dts/bindings/input-processor-caret.yaml
```yaml
# Copyright (c) 2024 The ZMK Contributors
# SPDX-License-Identifier: MIT

compatible: "zmk,input-processor-caret"

description: Custom input processor for pointer-to-caret (arrow keys).

properties:
  caret-tick:
    type: int
    required: false
    description: Delta threshold for arrow key press 
  track_remainders:
    type: int
    required: false
    description: Whether to track movement remainders (0 for false, non-zero for true) 
```

## config/west.yml
```yaml
manifest:
  remotes:
    - name: zmkfirmware
      url-base: https://github.com/petejohanson
    - name: inorichi
      url-base: https://github.com/inorichi
  projects:
    - name: zmk
      remote: zmkfirmware
      revision: feat/pointers-move-scroll
      import: app/west.yml
    - name: zmk-pmw3610-driver
      remote: inorichi
      revision: main
    - name: custom-caret-processor
      path: src
  self:
    path: config
```

## src/Kconfig.caret
```kconfig
# Опції конфігурації для кастомного input processor для caret режиму

config INPUT_PROCESSOR_CARET
	bool "Support for ZMK caret input processor"
	default n
	depends on ZMK_MOUSE
	help
	  This option enables support for the caret input processor,
	  which converts trackball movements to arrow key presses. 
```
